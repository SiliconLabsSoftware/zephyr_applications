## prj.conf
```kconfig
# CONFIG_DEBUG_OPTIMIZATIONS=y

CONFIG_MAIN_THREAD_PRIORITY=15
CONFIG_EVENTS=y

CONFIG_BT=y
CONFIG_BT_PERIPHERAL=y
CONFIG_BT_CENTRAL=y
CONFIG_BT_USER_PHY_UPDATE=y
CONFIG_BT_GATT_CLIENT=y
CONFIG_BT_GATT_AUTO_DISCOVER_CCC=y
CONFIG_BT_L2CAP_TX_MTU=247
CONFIG_BT_BUF_ACL_RX_SIZE=251
CONFIG_BT_BUF_ACL_TX_SIZE=251
CONFIG_BT_AUTO_PHY_UPDATE=n
# CONFIG_BT_TRANSMIT_POWER_CONTROL=y
CONFIG_BT_USER_PHY_UPDATE=y
CONFIG_BT_USER_DATA_LEN_UPDATE=y
#CONFIG_BT_L2CAP_TX_BUF_COUNT=6
CONFIG_BT_CTLR_CONN_RSSI=y

CONFIG_SHELL=y
CONFIG_GPIO=y
CONFIG_LOG=y
CONFIG_LOG_PROCESS_THREAD=y
CONFIG_LOG_BUFFER_SIZE=512
CONFIG_SYSTEM_WORKQUEUE_STACK_SIZE=8192
CONFIG_MAIN_STACK_SIZE=2752

CONFIG_THROUGHPUT_UI_LOG_ENABLE=y
```

## src/bt_event.c
```c
/***************************************************************************//**
 * @file bt_event.c
 * @brief
 *******************************************************************************
 * # License
 * <b>Copyright 2025 Silicon Laboratories Inc. www.silabs.com</b>
 *******************************************************************************
 *
 * SPDX-License-Identifier: Zlib
 *
 * The licensor of this software is Silicon Laboratories Inc.
 *
 * This software is provided \'as-is\', without any express or implied
 * warranty. In no event will the authors be held liable for any damages
 * arising from the use of this software.
 *
 * Permission is granted to anyone to use this software for any purpose,
 * including commercial applications, and to alter it and redistribute it
 * freely, subject to the following restrictions:
 *
 * 1. The origin of this software must not be misrepresented; you must not
 *    claim that you wrote the original software. If you use this software
 *    in a product, an acknowledgment in the product documentation would be
 *    appreciated but is not required.
 * 2. Altered source versions must be plainly marked as such, and must not be
 *    misrepresented as being the original software.
 * 3. This notice may not be removed or altered from any source distribution.
 *
 *******************************************************************************
 * # EXPERIMENTAL QUALITY
 * This code has not been formally tested and is provided as-is. It is not
 * suitable for production environments. In addition, this code will not be
 * maintained and there may be no bug maintenance planned for these resources.
 * Silicon Labs may update projects from time to time.
 ******************************************************************************/
#include <stdio.h>
#include <zephyr/logging/log.h>

#include "bt_event.h"

LOG_MODULE_REGISTER(bt_event, 3);

K_MSGQ_DEFINE(bt_evt_msgq, sizeof(struct bt_evt), 10, 1);

static bool conn_callbacks_registered = false;

static struct bt_gatt_discover_params discover_params;

/*******************************************************************************
 **************************   LOCAL FUNCTIONS   ********************************
 ******************************************************************************/
static const char *uuid_to_str(const struct bt_uuid *uuid)
{
  static char uuid_str[40];

  bt_uuid_to_str(uuid, uuid_str, sizeof(uuid_str));
  return uuid_str;
}

/**************************************************************************//**
 *  BLE connected callback.
 ******************************************************************************/
static void connected(struct bt_conn *connected, uint8_t err)
{
  struct bt_evt bt_evt;

  bt_evt.id = bt_evt_connection_opened_id;
  bt_evt.data.connection_opened.conn = connected;
  bt_evt.data.connection_opened.err = err;

  k_msgq_put(&bt_evt_msgq, &bt_evt, K_FOREVER);
}

/**************************************************************************//**
 *  BLE disconnected callback.
 ******************************************************************************/
static void disconnected(struct bt_conn *disconn, uint8_t reason)
{
  struct bt_evt bt_evt;

  bt_evt.id = bt_evt_connection_closed_id;
  bt_evt.data.connection_closed.conn = disconn;
  bt_evt.data.connection_closed.reason = reason;

  k_msgq_put(&bt_evt_msgq, &bt_evt, K_FOREVER);
}

static bool le_param_req(struct bt_conn *conn,
                         struct bt_le_conn_param *param)
{
  LOG_INF("le_param_req");
  return true;
}

static void param_updated(struct bt_conn *conn, uint16_t interval,
                          uint16_t latency, uint16_t timeout)
{
  struct bt_evt bt_evt;

  bt_evt.id = bt_evt_le_param_updated_id;
  bt_evt.data.le_param_updated.conn = conn;
  bt_evt.data.le_param_updated.interval = interval;
  bt_evt.data.le_param_updated.latency = latency;
  bt_evt.data.le_param_updated.timeout = timeout;

  k_msgq_put(&bt_evt_msgq, &bt_evt, K_FOREVER);
}

static sl_bt_gap_phy_coding_t get_bt_gap_phy_coding(uint8_t phy)
{
  switch (phy) {
    case BT_CONN_LE_TX_POWER_PHY_1M:
      return sl_bt_gap_phy_coding_1m_uncoded;

    case BT_CONN_LE_TX_POWER_PHY_2M:
      return sl_bt_gap_phy_coding_2m_uncoded;

    case BT_CONN_LE_TX_POWER_PHY_CODED_S8:
      return sl_bt_gap_phy_coding_125k_coded;

    case BT_CONN_LE_TX_POWER_PHY_CODED_S2:
      return sl_bt_gap_phy_coding_500k_coded;

    default:
      return 0;
  }
}

static void le_phy_updated(struct bt_conn *conn,
                           struct bt_conn_le_phy_info *param)
{
  struct bt_evt bt_evt;

  bt_evt.id = bt_evt_le_phy_updated_id;
  bt_evt.data.le_phy_updated.conn = conn;
  bt_evt.data.le_phy_updated.tx_phy = get_bt_gap_phy_coding(param->tx_phy);
  bt_evt.data.le_phy_updated.rx_phy = get_bt_gap_phy_coding(param->rx_phy);

  k_msgq_put(&bt_evt_msgq, &bt_evt, K_FOREVER);
}

static void le_data_len_updated(struct bt_conn *conn,
                                struct bt_conn_le_data_len_info *info)
{
  struct bt_evt bt_evt;

  bt_evt.id = bt_evt_le_data_len_updated_id;
  bt_evt.data.le_data_len_updated.conn = conn;
  bt_evt.data.le_data_len_updated.tx_max_len = info->tx_max_len;
  bt_evt.data.le_data_len_updated.tx_max_time = info->tx_max_time;
  bt_evt.data.le_data_len_updated.tx_max_time = info->rx_max_len;
  bt_evt.data.le_data_len_updated.tx_max_time = info->rx_max_time;

  k_msgq_put(&bt_evt_msgq, &bt_evt, K_FOREVER);
}

#if defined(CONFIG_BT_TRANSMIT_POWER_CONTROL)
static void tx_power_report(struct bt_conn *conn,
                            const struct bt_conn_le_tx_power_report *report)
{
  struct bt_evt bt_evt;

  bt_evt.id = bt_evt_tx_power_report_id;
  bt_evt.data.tx_power_report.conn = conn;
  bt_evt.data.tx_power_report.conn = conn;
  bt_evt.data.tx_power_report.reason = report->reason;
  bt_evt.data.tx_power_report.phy = get_bt_gap_phy_coding(report->phy);
  bt_evt.data.tx_power_report.tx_power_level = report->tx_power_level;
  bt_evt.data.tx_power_report.tx_power_level_flag = report->tx_power_level_flag;
  bt_evt.data.tx_power_report.delta = report->delta;

  k_msgq_put(&bt_evt_msgq, &bt_evt, K_FOREVER);
}

#endif /* CONFIG_BT_TRANSMIT_POWER_CONTROL */

static struct bt_conn_cb conn_callbacks = {
  .connected = connected,
  .disconnected = disconnected,
  .le_param_req = le_param_req,
  .le_param_updated = param_updated,
  .le_phy_updated = le_phy_updated,
  .le_data_len_updated = le_data_len_updated,
#if defined(CONFIG_BT_TRANSMIT_POWER_CONTROL)
  .tx_power_report = tx_power_report,
#endif /* CONFIG_BT_TRANSMIT_POWER_CONTROL */
};

static void mtu_exchange_callback(struct bt_conn *conn, uint8_t err,
                                  struct bt_gatt_exchange_params *params)
{
  struct bt_evt bt_evt;

  bt_evt.id = bt_evt_exchange_mtu_id;
  bt_evt.data.exchange_mtu.conn = conn;
  bt_evt.data.exchange_mtu.err = err;

  k_msgq_put(&bt_evt_msgq, &bt_evt, K_FOREVER);
}

int bt_evt_exchange_mtu(struct bt_conn *conn,
                        struct bt_gatt_exchange_params *params)
{
  // Start mtu exchange
  params->func = mtu_exchange_callback;

  return bt_gatt_exchange_mtu(conn, params);
}

static uint8_t discover_callback(struct bt_conn *conn,
                                 const struct bt_gatt_attr *attr,
                                 struct bt_gatt_discover_params *params)
{
  struct bt_evt bt_evt;
  uint8_t uuid_size;

  if (!attr) {
    LOG_INF("Discover complete");
    (void)memset(params, 0, sizeof(*params));
    return BT_GATT_ITER_STOP;
  }

  LOG_INF("attr uuid:   %s", uuid_to_str(attr->uuid));
  LOG_INF("params uuid: %s", uuid_to_str(params->uuid));

  bt_evt.id = bt_evt_gatt_discover_attrs_id;
  bt_evt.data.gatt_discover_attrs.conn = conn;
  if (params->uuid->type == BT_UUID_TYPE_16) {
    uuid_size = sizeof(struct bt_uuid_16);
  } else if (params->uuid->type == BT_UUID_TYPE_32) {
    uuid_size = sizeof(struct bt_uuid_32);
  } else {
    uuid_size = sizeof(struct bt_uuid_128);
  }
  memcpy(&(bt_evt.data.gatt_discover_attrs.uuid),
         params->uuid,
         uuid_size);
  bt_evt.data.gatt_discover_attrs.handle = attr->handle;
  bt_evt.data.gatt_discover_attrs.perm = attr->perm;
  bt_evt.data.gatt_discover_attrs.value_handle =
    bt_gatt_attr_value_handle(attr);

  k_msgq_put(&bt_evt_msgq, &bt_evt, K_FOREVER);

  return BT_GATT_ITER_STOP;
}

void le_scan_cb(const bt_addr_le_t *addr, int8_t rssi,
                uint8_t adv_type, struct net_buf_simple *buf)
{
  struct bt_evt bt_evt;

  bt_evt.id = bt_evt_le_scan_report_id;
  memcpy(&(bt_evt.data.le_scan_report.addr),
         addr,
         sizeof(bt_addr_le_t));
  bt_evt.data.le_scan_report.rssi = rssi;
  bt_evt.data.le_scan_report.type = adv_type;
  uint16_t len = ADV_DATA_MAX_LENGTH;
  if (len > buf->len) {
    len = buf->len;
  }
  memcpy(bt_evt.data.le_scan_report.buf.data, buf->data, len);

  k_msgq_put(&bt_evt_msgq, &bt_evt, K_FOREVER);
}

int bt_evt_le_scan_start(const struct bt_le_scan_param *param)
{
  return bt_le_scan_start(param, le_scan_cb);
}

int bt_evt_discover_attr(struct bt_conn *conn,
                         uint8_t type,
                         const struct bt_uuid *uuid,
                         uint16_t start_handle,
                         uint16_t end_handle)
{
  discover_params.type = type;
  discover_params.uuid = uuid;
  discover_params.func = discover_callback;
  discover_params.start_handle = start_handle;
  discover_params.end_handle = end_handle;
  LOG_INF("Start discover");
  return bt_gatt_discover(conn, &discover_params);
}

static uint8_t notification_callback(struct bt_conn *conn,
                                     struct bt_gatt_subscribe_params *params,
                                     const void *data, uint16_t length)
{
  struct bt_evt bt_evt;

  if (!data) {
    LOG_INF("[UNSUBSCRIBED]\n");
    params->value_handle = 0U;
    return BT_GATT_ITER_STOP;
  }

  bt_evt.id = bt_evt_gatt_characteristic_notification_id;
  bt_evt.data.gatt_characteristic_notification.conn = conn;
  bt_evt.data.gatt_characteristic_notification.value_handle =
    params->value_handle;
  if (length > ATTR_DATA_MAX_LENGTH) {
    length = ATTR_DATA_MAX_LENGTH;
  }
  memcpy(bt_evt.data.gatt_characteristic_notification.value.data,
         data,
         length);
  bt_evt.data.gatt_characteristic_notification.value.len = length;

  k_msgq_put(&bt_evt_msgq, &bt_evt, K_FOREVER);

  return BT_GATT_ITER_CONTINUE;
}

static void subscribe_status(struct bt_conn *conn, uint8_t err,
                             struct bt_gatt_subscribe_params *params)
{
  struct bt_evt bt_evt;

  bt_evt.id = bt_evt_gatt_characteristic_subscribe_status_id;
  bt_evt.data.gatt_characteristic_subscribe_status.conn = conn;
  bt_evt.data.gatt_characteristic_subscribe_status.err = err;
  bt_evt.data.gatt_characteristic_subscribe_status.params = params;

  k_msgq_put(&bt_evt_msgq, &bt_evt, K_FOREVER);
  LOG_INF("[SUBSCRIBE] status: %d, value_handle = %d", err,
          params->value_handle);
}

#if defined(CONFIG_BT_GATT_AUTO_DISCOVER_CCC)
int bt_evt_gatt_subscribe_for_notification(struct bt_conn *conn,
                                           struct bt_gatt_subscribe_params *params,
                                           struct bt_gatt_discover_params *disc_params)
{
  params->ccc_handle = 0;
  params->end_handle = BT_ATT_LAST_ATTRIBUTE_HANDLE;
  params->value = BT_GATT_CCC_NOTIFY;
  params->notify = notification_callback;
  params->subscribe = subscribe_status;
  params->disc_params = disc_params;
  return bt_gatt_subscribe(conn, params);
}

#else
int bt_evt_gatt_subscribe_for_notification(struct bt_conn *conn,
                                           struct bt_gatt_subscribe_params *params)
{
  params->ccc_handle = 0;
  params->end_handle = BT_ATT_LAST_ATTRIBUTE_HANDLE;
  params->value = BT_GATT_CCC_NOTIFY;
  params->notify = notification_callback;
  params->subscribe = subscribe_status;
  return bt_gatt_subscribe(conn, params);
}

#endif

static uint8_t indication_callback(struct bt_conn *conn,
                                   struct bt_gatt_subscribe_params *params,
                                   const void *data, uint16_t length)
{
  struct bt_evt bt_evt;

  if (!data) {
    LOG_INF("[UNSUBSCRIBED]\n");
    params->value_handle = 0U;
    return BT_GATT_ITER_STOP;
  }

  bt_evt.id = bt_evt_gatt_characteristic_indication_id;
  bt_evt.data.gatt_characteristic_indication.conn = conn;
  bt_evt.data.gatt_characteristic_indication.value_handle =
    params->value_handle;
  if (length > ATTR_DATA_MAX_LENGTH) {
    length = ATTR_DATA_MAX_LENGTH;
  }
  memcpy(bt_evt.data.gatt_characteristic_indication.value.data,
         data,
         length);
  bt_evt.data.gatt_characteristic_indication.value.len = length;

  k_msgq_put(&bt_evt_msgq, &bt_evt, K_FOREVER);

  return BT_GATT_ITER_CONTINUE;
}

#if defined(CONFIG_BT_GATT_AUTO_DISCOVER_CCC)
int bt_evt_gatt_subscribe_for_indication(struct bt_conn *conn,
                                         struct bt_gatt_subscribe_params *params,
                                         struct bt_gatt_discover_params *disc_params)
{
  params->ccc_handle = 0;
  params->end_handle = BT_ATT_LAST_ATTRIBUTE_HANDLE;
  params->value = BT_GATT_CCC_INDICATE;
  params->notify = indication_callback;
  params->subscribe = subscribe_status;
  params->disc_params = disc_params;
  return bt_gatt_subscribe(conn, params);
}

#else
int bt_evt_gatt_subscribe_for_indication(struct bt_conn *conn,
                                         struct bt_gatt_subscribe_params *params)
{
  params->ccc_handle = 0;
  params->end_handle = BT_ATT_LAST_ATTRIBUTE_HANDLE;
  params->value = BT_GATT_CCC_INDICATE;
  params->notify = indication_callback;
  params->subscribe = subscribe_status;
  return bt_gatt_subscribe(conn, params);
}

#endif

int bt_evt_wait_event(struct bt_evt *evt, k_timeout_t timeout)
{
  return k_msgq_get(&bt_evt_msgq, evt, timeout);
}

int bt_evt_external_signal(uint32_t signals)
{
  struct bt_evt bt_evt;

  bt_evt.id = bt_evt_system_external_signal_id;
  bt_evt.data.system_external_signal.extsignals = signals;
  return k_msgq_put(&bt_evt_msgq, &bt_evt, K_FOREVER);
}

void bt_evt_init(void)
{
  if (!conn_callbacks_registered) {
    bt_conn_cb_register(&conn_callbacks);
    conn_callbacks_registered = true;
  }
}
```

## src/bt_event.h
```c
/***************************************************************************//**
 * @file bt_event.h
 * @brief
 *******************************************************************************
 * # License
 * <b>Copyright 2025 Silicon Laboratories Inc. www.silabs.com</b>
 *******************************************************************************
 *
 * SPDX-License-Identifier: Zlib
 *
 * The licensor of this software is Silicon Laboratories Inc.
 *
 * This software is provided \'as-is\', without any express or implied
 * warranty. In no event will the authors be held liable for any damages
 * arising from the use of this software.
 *
 * Permission is granted to anyone to use this software for any purpose,
 * including commercial applications, and to alter it and redistribute it
 * freely, subject to the following restrictions:
 *
 * 1. The origin of this software must not be misrepresented; you must not
 *    claim that you wrote the original software. If you use this software
 *    in a product, an acknowledgment in the product documentation would be
 *    appreciated but is not required.
 * 2. Altered source versions must be plainly marked as such, and must not be
 *    misrepresented as being the original software.
 * 3. This notice may not be removed or altered from any source distribution.
 *
 *******************************************************************************
 * # EXPERIMENTAL QUALITY
 * This code has not been formally tested and is provided as-is. It is not
 * suitable for production environments. In addition, this code will not be
 * maintained and there may be no bug maintenance planned for these resources.
 * Silicon Labs may update projects from time to time.
 ******************************************************************************/
#ifndef BT_EVENT_H_
#define BT_EVENT_H_

#include <zephyr/bluetooth/bluetooth.h>
#include <zephyr/bluetooth/conn.h>
#include <zephyr/bluetooth/uuid.h>
#include <zephyr/bluetooth/gatt.h>
#include <zephyr/bluetooth/gap.h>
#include "throughput_ui_types.h"

#define ADV_DATA_MAX_LENGTH 255
typedef struct {
  bt_addr_le_t addr;
  int8_t rssi;
  uint8_t type;
  struct {
    uint16_t len;
    uint8_t data[ADV_DATA_MAX_LENGTH];
  } buf;
} bt_evt_le_scan_report_t;

#define ATTR_DATA_MAX_LENGTH 255
enum bt_evt_event_id {
  bt_evt_connection_opened_id,
  bt_evt_connection_closed_id,
  bt_evt_le_param_updated_id,
  bt_evt_le_phy_updated_id,
  bt_evt_le_data_len_updated_id,
  bt_evt_le_scan_report_id,
#if defined(CONFIG_BT_TRANSMIT_POWER_CONTROL)
  bt_evt_tx_power_report_id,
#endif /* CONFIG_BT_TRANSMIT_POWER_CONTROL */
  bt_evt_exchange_mtu_id,
  bt_evt_gatt_discover_attrs_id,
  bt_evt_gatt_characteristic_subscribe_status_id,
  bt_evt_gatt_characteristic_notification_id,
  bt_evt_gatt_characteristic_indication_id,
  bt_evt_system_external_signal_id
};

struct bt_evt {
  enum bt_evt_event_id id;
  union {
    struct {
      struct bt_conn *conn;
      uint8_t err;
    } connection_opened;

    struct {
      struct bt_conn *conn;
      uint8_t reason;
    } connection_closed;

    struct {
      struct bt_conn *conn;
      uint16_t interval;
      uint16_t latency;
      uint16_t timeout;
    } le_param_updated;

    struct {
      struct bt_conn *conn;
      uint16_t tx_max_len;
      uint16_t tx_max_time;
      uint16_t rx_max_len;
      uint16_t rx_max_time;
    } le_data_len_updated;

    bt_evt_le_scan_report_t le_scan_report;

#if defined(CONFIG_BT_TRANSMIT_POWER_CONTROL)
    struct {
      struct bt_conn *conn;
      uint8_t reason;
      sl_bt_gap_phy_coding_t phy;
      int8_t tx_power_level;
      uint8_t tx_power_level_flag;
      int8_t delta;
    } tx_power_report;
#endif /* CONFIG_BT_TRANSMIT_POWER_CONTROL */

    struct {
      struct bt_conn *conn;
      uint8_t err;
    } exchange_mtu;

    struct {
      struct bt_conn *conn;
      sl_bt_gap_phy_coding_t tx_phy;
      sl_bt_gap_phy_coding_t rx_phy;
    } le_phy_updated;

    struct {
      struct bt_conn *conn;
      uint16_t handle;
      uint16_t perm;
      uint16_t value_handle;
      union {
        struct bt_uuid uuid;
        struct bt_uuid_16 uuid16;
        struct bt_uuid_32 uuid32;
        struct bt_uuid_128 uuid128;
      };
    } gatt_discover_attrs;

    struct {
      struct bt_conn *conn;
      uint8_t err;
      struct bt_gatt_subscribe_params *params;
    } gatt_characteristic_subscribe_status;

    struct {
      struct bt_conn *conn;
      uint16_t value_handle;
      struct {
        uint8_t len;
        uint8_t data[ATTR_DATA_MAX_LENGTH];
      } value;
    } gatt_characteristic_notification;

    struct {
      struct bt_conn *conn;
      uint16_t value_handle;
      struct {
        uint8_t len;
        uint8_t data[ATTR_DATA_MAX_LENGTH];
      } value;
    } gatt_characteristic_indication;

    struct {
      uint32_t extsignals;
    } system_external_signal;
  } data;
};

int bt_evt_le_scan_start(const struct bt_le_scan_param *param);

int bt_evt_exchange_mtu(struct bt_conn *conn,
                        struct bt_gatt_exchange_params *params);

int bt_evt_discover_attr(struct bt_conn *conn,
                         uint8_t type,
                         const struct bt_uuid *uuid,
                         uint16_t start_handle,
                         uint16_t end_handle);

#if defined(CONFIG_BT_GATT_AUTO_DISCOVER_CCC)
int bt_evt_gatt_subscribe_for_notification(struct bt_conn *conn,
                                           struct bt_gatt_subscribe_params *params,
                                           struct bt_gatt_discover_params *disc_params);

#else
int bt_evt_gatt_subscribe_for_notification(struct bt_conn *conn,
                                           struct bt_gatt_subscribe_params *params);

#endif

#if defined(CONFIG_BT_GATT_AUTO_DISCOVER_CCC)
int bt_evt_gatt_subscribe_for_indication(struct bt_conn *conn,
                                         struct bt_gatt_subscribe_params *params,
                                         struct bt_gatt_discover_params *disc_params);

#else
int bt_evt_gatt_subscribe_for_indication(struct bt_conn *conn,
                                         struct bt_gatt_subscribe_params *params);

#endif

int bt_evt_wait_event(struct bt_evt *evt, k_timeout_t timeout);

int bt_evt_external_signal(uint32_t signals);

void bt_evt_init(void);

#endif // BT_EVENT_H_
```

## src/throughput_ui_log.c
```c
/***************************************************************************//**
 * @file throughput_ui_log.c
 * @brief
 *******************************************************************************
 * # License
 * <b>Copyright 2025 Silicon Laboratories Inc. www.silabs.com</b>
 *******************************************************************************
 *
 * SPDX-License-Identifier: Zlib
 *
 * The licensor of this software is Silicon Laboratories Inc.
 *
 * This software is provided 'as-is', without any express or implied
 * warranty. In no event will the authors be held liable for any damages
 * arising from the use of this software.
 *
 * Permission is granted to anyone to use this software for any purpose,
 * including commercial applications, and to alter it and redistribute it
 * freely, subject to the following restrictions:
 *
 * 1. The origin of this software must not be misrepresented; you must not
 *    claim that you wrote the original software. If you use this software
 *    in a product, an acknowledgment in the product documentation would be
 *    appreciated but is not required.
 * 2. Altered source versions must be plainly marked as such, and must not be
 *    misrepresented as being the original software.
 * 3. This notice may not be removed or altered from any source distribution.
 *
 *******************************************************************************
 * # EXPERIMENTAL QUALITY
 * This code has not been formally tested and is provided as-is. It is not
 * suitable for production environments. In addition, this code will not be
 * maintained and there may be no bug maintenance planned for these resources.
 * Silicon Labs may update projects from time to time.
 ******************************************************************************/

#include <string.h>
#include <stdio.h>

#include <zephyr/bluetooth/bluetooth.h>
#include <zephyr/bluetooth/conn.h>
#include <zephyr/bluetooth/uuid.h>
#include <zephyr/bluetooth/gatt.h>
#include <zephyr/bluetooth/gap.h>

#include "throughput_ui_log_config.h"
#include "throughput_ui.h"
#include "throughput_ui_types.h"

#if defined(THROUGHPUT_UI_LOG_ENABLE) && THROUGHPUT_UI_LOG_ENABLE
#define UI_PRINTF(...)   printk(__VA_ARGS__)
#if defined(THROUGHPUT_UI_LOG_REFRESH_ALL) && THROUGHPUT_UI_LOG_REFRESH_ALL
#define REFRESH_ONE(x)
#define REFRESH_ALL(x)   refresh_ui(x)
#if defined(THROUGHPUT_UI_LOG_BOX_ENABLE) && THROUGHPUT_UI_LOG_BOX_ENABLE

#define BOX_T       "_"
#define BOX_S       "|"

#define UI_PRINTBOX(...) printk(__VA_ARGS__)
#else // THROUGHPUT_UI_LOG_BOX_ENABLE
#define UI_PRINTBOX(...)
#endif // THROUGHPUT_UI_LOG_BOX_ENABLE
#else // THROUGHPUT_UI_LOG_REFRESH_ALL
#define REFRESH_ONE(x)   refresh_ui(x)
#define REFRESH_ALL(x)
#define UI_PRINTBOX(...)
#endif // THROUGHPUT_UI_LOG_REFRESH_ALL
#else // THROUGHPUT_UI_LOG_ENABLE
#define UI_PRINTF(...)
#define UI_PRINTBOX(...)
#define REFRESH_ALL(x)
#define REFRESH_ONE(x)
#endif // THROUGHPUT_UI_LOG_ENABLE

#define UI_LOG_NEW_LINE "\n"

/*******************************************************************************
 ***************************  LOCAL VARIABLES   ********************************
 ******************************************************************************/
/// Internal state
static throughput_t ui_state;
static throughput_t ui_state_last;

/*******************************************************************************
 **************************   LOCAL FUNCTIONS   ********************************
 ******************************************************************************/

// Function to a row on UI
static void refresh_ui(uint8_t refresh_row)
{
  uint8_t row;
  uint8_t col;

  uint8_t row_begin = 0;
  uint8_t row_end = THROUGHPUT_UI_ROWS;

  if (0 == memcmp(&ui_state_last, &ui_state, sizeof(throughput_t))) {
    return;
  }
  ui_state_last = ui_state;
  if (refresh_row != ROW_ALL) {
    row_begin = refresh_row;
    row_end = row_begin + 1;
  }

  for (col = 0; col < THROUGHPUT_UI_COLS + 2; col++) {
    UI_PRINTBOX(BOX_T);
  }
  UI_PRINTBOX(UI_LOG_NEW_LINE);

  for (row = row_begin; row < row_end; row++) {
    UI_PRINTBOX(BOX_S);
    switch (row) {
      case ROW_ROLE:
        if (ui_state.role == THROUGHPUT_ROLE_PERIPHERAL) {
          UI_PRINTF(THROUGHPUT_UI_ROLE_PERIPHERAL_TEXT);
          UI_PRINTBOX("");
        } else {
          UI_PRINTF(THROUGHPUT_UI_ROLE_CENTRAL_TEXT);
          UI_PRINTBOX("   ");
        }
        break;
      case ROW_STATE:
        switch (ui_state.state) {
          case THROUGHPUT_STATE_CONNECTED:
            UI_PRINTF(THROUGHPUT_UI_STATE_CONNECTED_TEXT);
            UI_PRINTBOX("   ");
            break;
          case THROUGHPUT_STATE_SUBSCRIBED:
            UI_PRINTF(THROUGHPUT_UI_STATE_SUBSCRIBED_TEXT);
            UI_PRINTBOX("  ");
            break;
          case THROUGHPUT_STATE_TEST:
            UI_PRINTF(THROUGHPUT_UI_STATE_TEST_TEXT);
            UI_PRINTBOX("     ");
            break;
          default:
            UI_PRINTF(THROUGHPUT_UI_STATE_DISCONNECTED_TEXT);
            UI_PRINTBOX("    ");
            break;
        }
        break;
      case ROW_TX_POWER:
        UI_PRINTF(THROUGHPUT_UI_TX_POWER_FORMAT, ((int)(ui_state.tx_power)));
        UI_PRINTBOX("    ");
        break;
      case ROW_RSSI:
        UI_PRINTF(THROUGHPUT_UI_RSSI_FORMAT, (int)ui_state.rssi);
        UI_PRINTBOX("  ");
        break;
      case ROW_INTERVAL:
        UI_PRINTF(THROUGHPUT_UI_INTERVAL_FORMAT,
                  (int)(ui_state.interval * 1.25));
        UI_PRINTBOX("  ");
        break;
      case ROW_PDU_SIZE:
        UI_PRINTF(THROUGHPUT_UI_PDU_SIZE_FORMAT, (int)ui_state.pdu_size);
        UI_PRINTBOX("        ");
        break;
      case ROW_MTU_SIZE:
        UI_PRINTF(THROUGHPUT_UI_MTU_SIZE_FORMAT, (int)ui_state.mtu_size);
        UI_PRINTBOX("        ");
        break;
      case ROW_DATA_SIZE:
        UI_PRINTF(THROUGHPUT_UI_DATA_SIZE_FORMAT, (int)ui_state.data_size);
        UI_PRINTBOX("       ");
        break;
      case ROW_PHY:
        switch (ui_state.phy) {
          case sl_bt_gap_phy_coding_1m_uncoded:
            UI_PRINTF(THROUGHPUT_UI_PHY_1M_TEXT);
            UI_PRINTBOX("         ");
            break;
          case sl_bt_gap_phy_coding_2m_uncoded:
            UI_PRINTF(THROUGHPUT_UI_PHY_2M_TEXT);
            UI_PRINTBOX("         ");
            break;
          case sl_bt_gap_phy_coding_125k_coded:
            UI_PRINTF(THROUGHPUT_UI_PHY_CODED_125K_TEXT);
            UI_PRINTBOX(" ");
            break;
          case sl_bt_gap_phy_coding_500k_coded:
            UI_PRINTF(THROUGHPUT_UI_PHY_CODED_500K_TEXT);
            UI_PRINTBOX(" ");
            break;
          default:
            UI_PRINTF(THROUGHPUT_UI_PHY_UNKNOWN_TEXT);
            UI_PRINTBOX("          ");
            break;
        }
        break;
      case ROW_NOTIFY:
        switch (ui_state.notifications) {
          case BT_GATT_CCC_NOTIFY:
            UI_PRINTF(THROUGHPUT_UI_NOTIFY_YES_TEXT);
            UI_PRINTBOX("     ");
            break;
          default:
            UI_PRINTF(THROUGHPUT_UI_NOTIFY_NO_TEXT);
            UI_PRINTBOX("      ");
            break;
        }
        break;
      case ROW_INDICATE:
        switch (ui_state.indications) {
          case BT_GATT_CCC_INDICATE:
            UI_PRINTF(THROUGHPUT_UI_INDICATE_YES_TEXT);
            UI_PRINTBOX("   ");
            break;
          default:
            UI_PRINTF(THROUGHPUT_UI_INDICATE_NO_TEXT);
            UI_PRINTBOX("    ");
            break;
        }
        break;
      case ROW_THROUGHPUT:
        UI_PRINTF(THROUGHPUT_UI_TH_FORMAT, (int)ui_state.throughput);
        UI_PRINTBOX(" ");
        break;
      case ROW_COUNT:
        UI_PRINTF(THROUGHPUT_UI_CNT_FORMAT, (int)ui_state.count);
        UI_PRINTBOX("  ");
        break;
      default:
        for (col = 0; col < THROUGHPUT_UI_COLS; col++) {
          UI_PRINTBOX(" ");
        }
        break;
    }
    UI_PRINTBOX(BOX_S);
    UI_PRINTF(UI_LOG_NEW_LINE);
  }
  for (col = 0; col < THROUGHPUT_UI_COLS + 2; col++) {
    UI_PRINTBOX(BOX_T);
  }
  UI_PRINTBOX(UI_LOG_NEW_LINE);
}

/*******************************************************************************
 **************************   GLOBAL FUNCTIONS   *******************************
 ******************************************************************************/

/**************************************************************************//**
 * Initilize the the UI.
 *****************************************************************************/
void throughput_ui_init(void)
{
}

/**************************************************************************//**
 * Updates the the UI.
 *****************************************************************************/
void throughput_ui_update(void)
{
  REFRESH_ALL(ROW_ALL);
}

/**************************************************************************//**
 * Sets the state value on UI.
 *****************************************************************************/
void throughput_ui_set_state(throughput_state_t state)
{
  ui_state.state = state;
  REFRESH_ONE(ROW_STATE);
}

/**************************************************************************//**
 * Sets the role value on UI.
 *****************************************************************************/
void throughput_ui_set_role(throughput_role_t role)
{
  ui_state.role = role;
  REFRESH_ONE(ROW_ROLE);
}

/**************************************************************************//**
 * Sets the TX Power value on UI.
 *****************************************************************************/
void throughput_ui_set_tx_power(throughput_tx_power_t power)
{
  ui_state.tx_power = power;
  REFRESH_ONE(ROW_TX_POWER);
}

/**************************************************************************//**
 * Sets the RSSI value on UI.
 *****************************************************************************/
void throughput_ui_set_rssi(throughput_rssi_t rssi)
{
  ui_state.rssi = rssi;
  REFRESH_ONE(ROW_RSSI);
}

/**************************************************************************//**
 * Sets the connection interval value on UI.
 *****************************************************************************/
void throughput_ui_set_connection_interval(throughput_time_t interval)
{
  ui_state.interval = interval;
  REFRESH_ONE(ROW_INTERVAL);
}

/**************************************************************************//**
 *   Sets the PDU size value on UI.
 *****************************************************************************/
void throughput_ui_set_pdu_size(throughput_pdu_size_t size)
{
  ui_state.pdu_size = size;
  REFRESH_ONE(ROW_PDU_SIZE);
}

/**************************************************************************//**
 * Sets the MTU size value on UI.
 *****************************************************************************/
void throughput_ui_set_mtu_size(throughput_mtu_size_t size)
{
  ui_state.mtu_size = size;
  REFRESH_ONE(ROW_MTU_SIZE);
}

/**************************************************************************//**
 * Sets the data size value on UI.
 *****************************************************************************/
void throughput_ui_set_data_size(throughput_data_size_t size)
{
  ui_state.data_size = size;
  REFRESH_ONE(ROW_DATA_SIZE);
}

/**************************************************************************//**
 * Sets the PHY on UI.
 *****************************************************************************/
void throughput_ui_set_phy(throughput_phy_t phy)
{
  ui_state.phy = phy;
  REFRESH_ONE(ROW_PHY);
}

/**************************************************************************//**
 * Sets the notification state on UI.
 *****************************************************************************/
void throughput_ui_set_notifications(throughput_notification_t notifications)
{
  ui_state.notifications = notifications;
  REFRESH_ONE(ROW_NOTIFY);
}

/**************************************************************************//**
 * Sets the indication state on UI.
 *****************************************************************************/
void throughput_ui_set_indications(throughput_notification_t indications)
{
  ui_state.indications = indications;
  REFRESH_ONE(ROW_INDICATE);
}

/**************************************************************************//**
 * Sets the throughput value on UI.
 *****************************************************************************/
void throughput_ui_set_throughput(throughput_value_t throughput)
{
  ui_state.throughput = throughput;
  REFRESH_ONE(ROW_THROUGHPUT);
}

/**************************************************************************//**
 * Sets the counter value on UI.
 *****************************************************************************/
void throughput_ui_set_count(throughput_count_t count)
{
  ui_state.count = count;
  REFRESH_ONE(ROW_COUNT);
}
```

## src/throughput_ui_types.h
```c
/***************************************************************************//**
 * @file throughput_ui_types.h
 * @brief
 *******************************************************************************
 * # License
 * <b>Copyright 2025 Silicon Laboratories Inc. www.silabs.com</b>
 *******************************************************************************
 *
 * SPDX-License-Identifier: Zlib
 *
 * The licensor of this software is Silicon Laboratories Inc.
 *
 * This software is provided 'as-is', without any express or implied
 * warranty. In no event will the authors be held liable for any damages
 * arising from the use of this software.
 *
 * Permission is granted to anyone to use this software for any purpose,
 * including commercial applications, and to alter it and redistribute it
 * freely, subject to the following restrictions:
 *
 * 1. The origin of this software must not be misrepresented; you must not
 *    claim that you wrote the original software. If you use this software
 *    in a product, an acknowledgment in the product documentation would be
 *    appreciated but is not required.
 * 2. Altered source versions must be plainly marked as such, and must not be
 *    misrepresented as being the original software.
 * 3. This notice may not be removed or altered from any source distribution.
 *
 *******************************************************************************
 * # EXPERIMENTAL QUALITY
 * This code has not been formally tested and is provided as-is. It is not
 * suitable for production environments. In addition, this code will not be
 * maintained and there may be no bug maintenance planned for these resources.
 * Silicon Labs may update projects from time to time.
 ******************************************************************************/

#ifndef THROUGHPUT_UI_TYPES_H_
#define THROUGHPUT_UI_TYPES_H_

/*******************************************************************************
 ******************************   DEFINITIONS   ********************************
 ******************************************************************************/
#define THROUGHPUT_UI_ROWS        13
#define THROUGHPUT_UI_COLS        16

/*******************************************************************************
 ********************************  TYPEDEFS  ***********************************
 ******************************************************************************/

// Enum type for UI rows
typedef enum {
  ROW_ROLE        = 0,
  ROW_STATE       = 1,
  ROW_TX_POWER    = 2,
  ROW_RSSI        = 3,
  ROW_PHY         = 4,
  ROW_INTERVAL    = 5,
  ROW_PDU_SIZE    = 6,
  ROW_MTU_SIZE    = 7,
  ROW_DATA_SIZE   = 8,
  ROW_NOTIFY      = 9,
  ROW_INDICATE    = 10,
  ROW_THROUGHPUT  = 11,
  ROW_COUNT       = 12,
  ROW_ALL         = THROUGHPUT_UI_ROWS
} throughput_ui_row;

/**
 * @brief PHY types with coding schemes
 */
typedef enum
{
  sl_bt_gap_phy_coding_1m_uncoded = 0x1, /**< (0x1) 1M PHY */
  sl_bt_gap_phy_coding_2m_uncoded = 0x2, /**< (0x2) 2M PHY */
  sl_bt_gap_phy_coding_125k_coded = 0x4, /**< (0x4) 125k Coded PHY (S=8) */
  sl_bt_gap_phy_coding_500k_coded = 0x8  /**< (0x8) 500k Coded PHY (S=2) */
} sl_bt_gap_phy_coding_t;

#define THROUGHPUT_UI_YESNO(x)                   ((x) ? ("Yes") : ("No"))

#define THROUGHPUT_UI_ROLE_PERIPHERAL_TEXT                 "ROLE: PERIPHERAL"
#define THROUGHPUT_UI_ROLE_CENTRAL_TEXT                    "ROLE: CENTRAL"

#define THROUGHPUT_UI_STATE_CONNECTED_TEXT                 "ST: Connected"
#define THROUGHPUT_UI_STATE_DISCONNECTED_TEXT              "ST: Disconn."
#define THROUGHPUT_UI_STATE_SUBSCRIBED_TEXT                "ST: Subscribed"
#define THROUGHPUT_UI_STATE_TEST_TEXT                      "ST: Testing"
#define THROUGHPUT_UI_STATE_UNKNOWN_TEXT                   "ST: Unknown"
#define THROUGHPUT_UI_STATE_UNINITIALIZED_TEXT             "ST: Uninited"
#define THROUGHPUT_UI_STATE_UNINITIALIZING_TEXT            "ST: Uninit"

#define THROUGHPUT_UI_TX_POWER_FORMAT                      "TX: %+4d dBm"
#define THROUGHPUT_UI_RSSI_FORMAT                          "RSSI: %+4d dBm"
#define THROUGHPUT_UI_INTERVAL_FORMAT                      "INTERVAL: %04d"
#define THROUGHPUT_UI_LATENCY_FORMAT                       "LATENCY: %04d"
#define THROUGHPUT_UI_TIMEOUT_FORMAT                       "TIMEOUT: %04d"

#define THROUGHPUT_UI_PDU_SIZE_FORMAT                      "PDU: %3d"
#define THROUGHPUT_UI_MTU_SIZE_FORMAT                      "MTU: %3d"
#define THROUGHPUT_UI_DATA_SIZE_FORMAT                     "DATA: %3d"

#define THROUGHPUT_UI_PHY_1M_TEXT                          "PHY: 1M"
#define THROUGHPUT_UI_PHY_2M_TEXT                          "PHY: 2M"
#define THROUGHPUT_UI_PHY_CODED_125K_TEXT                  "PHY: CODED 125K"
#define THROUGHPUT_UI_PHY_CODED_500K_TEXT                  "PHY: CODED 500K"
#define THROUGHPUT_UI_PHY_UNKNOWN_TEXT                     "PHY: -"

#define THROUGHPUT_UI_NOTIFY_YES_TEXT                      "NOTIFY: Yes"
#define THROUGHPUT_UI_NOTIFY_NO_TEXT                       "NOTIFY: No"

#define THROUGHPUT_UI_INDICATE_YES_TEXT                    "INDICATE: Yes"
#define THROUGHPUT_UI_INDICATE_NO_TEXT                     "INDICATE: No"

#define THROUGHPUT_UI_RESULT_YES_TEXT                      "RESULT: Yes"
#define THROUGHPUT_UI_RESULT_NO_TEXT                       "RESULT: No"

#define THROUGHPUT_UI_TH_FORMAT                            "TH: %07d bps"
#define THROUGHPUT_UI_CNT_FORMAT                           "CNT: %09d"
#define THROUGHPUT_UI_LOST_FORMAT                          "LOST: %09d"
#define THROUGHPUT_UI_ERROR_FORMAT                         "ERR: %09d"
#define THROUGHPUT_UI_TIME_FORMAT                          "TIME: %09d"

#define THROUGHPUT_UI_DISCOVERY_STATE_IDLE_TEXT            "DISCOVERY: IDLE"
#define THROUGHPUT_UI_DISCOVERY_STATE_CONN_TEXT \
  "DISCOVERY: CONNECTING"
#define THROUGHPUT_UI_DISCOVERY_STATE_SCAN_TEXT            "DISCOVERY: SCAN"
#define THROUGHPUT_UI_DISCOVERY_STATE_SERVICE_TEXT         "DISCOVERY: SERVICE"
#define THROUGHPUT_UI_DISCOVERY_STATE_CHARACTERISTICS_TEXT \
  "DISCOVERY: CHARACTERISTICS"
#define THROUGHPUT_UI_DISCOVERY_STATE_FINISHED_TEXT        "DISCOVERY: FINISHED"
#define THROUGHPUT_UI_DISCOVERY_STATE_UNKNOWN_TEXT         "DISCOVERY: UNKNOWN"

#define THROUGHPUT_UI_CHARACTERISTICS_FOUND_FORMAT \
  "CHARACTERISTICS: "                              \
  "NOTIFY: %s INDICATE %s TRANSMISSION %s RESULT: %s"

#endif
```
