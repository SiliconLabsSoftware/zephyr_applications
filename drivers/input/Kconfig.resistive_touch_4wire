## drivers/input/Kconfig.resistive_touch_4wire
```kconfig
# SPDX-License-Identifier: Apache-2.0

config INPUT_RESISTIVE_TOUCHSCREEN_4WIRE
	bool "ADC Resistive touch"
	default y
	depends on DT_HAS_RESISTIVE_TOUCHSCREEN_4WIRE_ENABLED
	depends on MULTITHREADING
	select ADC
	select GPIO
	help
	  ADC based resistive touch screen input driver

if INPUT_RESISTIVE_TOUCHSCREEN_4WIRE

config INPUT_RESISTIVE_TOUCHSCREEN_4WIRE_THREAD_STACK_SIZE
	int "Stack size for the resistive touch screen thread"
	default 1536
	help
	  Size of the stack used for the resistive touch screen thread.

config INPUT_RESISTIVE_TOUCHSCREEN_4WIRE_THREAD_PRIORITY
	int "Priority for the resistive touch screen thread"
	default 0
	help
	  Priority level of the resistive touch screen thread.

config INPUT_RESISTIVE_TOUCHSCREEN_4WIRE_SETTINGS
	bool "Resistive touch screen settings support"
	default y
	depends on SETTINGS
	help
	  Settings support for the resistive touch screen driver, exposes a
	  resistive_touchscreen_4wire_calibration_save() function to save the calibration into
	  settings and load them automatically on startup.

endif
```

## west.yml
```yaml
# Copyright (c) 2025 Silicon Laboratories Inc. www.silabs.com
# SPDX-License-Identifier: Apache-2.0

manifest:
  self:
    west-commands: scripts/west-commands.yml

  remotes:
    - name: zephyrproject-rtos
      url-base: https://github.com/zephyrproject-rtos

  projects:
    - name: zephyr
      remote: zephyrproject-rtos
      revision: v4.2.0
      import:
        # By using name-allowlist we can clone only the modules that are
        # strictly needed by the application.
        name-allowlist:
          - mcuboot
          - cmsis_6      # required by the ARM port
          - hal_silabs
          - lvgl
          - mbedtls
          - tinycrypt
```
